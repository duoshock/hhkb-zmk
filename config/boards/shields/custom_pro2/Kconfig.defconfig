## config/boards/shields/custom_pro2/Kconfig.defconfig
```kconfig
if SHIELD_CUSTOM_PRO2

config ZMK_KEYBOARD_NAME
    default "Heavy Grail ZMK"

endif
```

## config/boards/shields/hhkb_pro2/Kconfig.defconfig
```kconfig
if SHIELD_HHKB_PRO2_DONGLE

config ZMK_KEYBOARD_NAME
    default "HHKB Dongle"

config ZMK_SPLIT
	default y

config ZMK_SPLIT_ROLE_CENTRAL
	default y

endif

if SHIELD_HHKB_PRO2_MAIN

config ZMK_KEYBOARD_NAME
    default "HHKB Main"

config ZMK_SPLIT
	default y

endif
```

## config/boards/shields/hhkb_pro2/Kconfig.shield
```kconfig
config SHIELD_HHKB_PRO2_DONGLE
    def_bool $(shields_list_contains,hhkb_pro2_dongle)
    depends on KSCAN_HHKB_PRO2

config SHIELD_HHKB_PRO2_MAIN
    def_bool $(shields_list_contains,hhkb_pro2_main)
    depends on KSCAN_HHKB_PRO2
```
